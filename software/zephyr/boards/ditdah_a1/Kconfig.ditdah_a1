## software/zephyr/boards/ditdah_a1/Kconfig.ditdah_a1
```kconfig
# SPDX-FileCopyrightText: 2026 Huang Rui <vowstar@gmail.com>
# SPDX-License-Identifier: MIT
config BOARD_DITDAH_A1
	select SOC_DITDAH_A1
```

## software/zephyr/boards/ditdah_a1/board.yml
```yaml
# SPDX-FileCopyrightText: 2026 Huang Rui <vowstar@gmail.com>
# SPDX-License-Identifier: MIT
board:
  name: ditdah_a1
  full_name: DitDah-A1
  vendor: vowstar
  socs:
    - name: ditdah_a1
```

## software/zephyr/boards/ditdah_a1/ditdah_a1_defconfig
```kconfig
# SPDX-FileCopyrightText: 2026 Huang Rui <vowstar@gmail.com>
# SPDX-License-Identifier: MIT
CONFIG_CONSOLE=y
CONFIG_SERIAL=n
CONFIG_UART_CONSOLE=n
```

## software/zephyr/soc/ditdah_a1/Kconfig
```kconfig
# SPDX-FileCopyrightText: 2026 Huang Rui <vowstar@gmail.com>
# SPDX-License-Identifier: MIT
config SOC_DITDAH_A1
	select RISCV
	select RISCV_PRIVILEGED
	select INCLUDE_RESET_VECTOR
	select RISCV_SOC_HAS_GP_RELATIVE_ADDRESSING
if SOC_DITDAH_A1
config NUM_IRQS
	default 16
config PMP_SLOTS
	default 16
endif
```

## software/zephyr/soc/ditdah_a1/Kconfig.soc
```kconfig
# SPDX-FileCopyrightText: 2026 Huang Rui <vowstar@gmail.com>
# SPDX-License-Identifier: MIT
config SOC_DITDAH_A1
	bool
config SOC
	default "ditdah_a1" if SOC_DITDAH_A1
```
